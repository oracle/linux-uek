## drivers/firmware/octeontx2/Kconfig
```kconfig
# SPDX-License-Identifier: GPL-2.0
#
# Marvell Utility Bus for firmware
#

menuconfig MARVELL_UB
	bool "Marvell Utility Bus"
	default n
	depends on ARM64 && SYSFS
	help
	  Marvell Utility Bus provides set of drivers allowing communication
	  with various services provided by firmware for OcteonTX2
	  based platforms.
	  These drivers are useful only for Marvell CN9X and CN10X SoCs.
	  If unsure, say N here.

if MARVELL_UB

config MARVELL_UB_GEN_DRIVER
	tristate "Generic driver for OcteonTX2 & CN10K platforms"
	default y
	depends on MARVELL_UB && HAVE_ARM_SMCCC
	help
	  The generic driver provides a generic implementation of
	  platform detection and firmware services.
	  By default the drvier handles CN9X and CN10X platforms.
	  If unsure, say Y here.

config MARVELL_SFP_INFO
	bool "Marvell SFP info sysfs interface"
	depends on HAVE_ARM_SMCCC
	select MARVELL_UB_GEN_DRIVER
	default n
	help
	  Enable support for sysfs entries to dump SFP module information
	  in similar way as the 'ethtool -m <etxX>' command.
	  Currently, works only with cn10k platforms.
	  If unsure, say N here.

endif # MARVELL_UB
```

## drivers/infiniband/hw/sif/Kconfig
```kconfig
config INFINIBAND_SIF
	tristate "Oracle Infiniband HCA support"
	depends on PCI && 64BIT && HAS_DMA
	---help---
	  Low level driver for Oracle's family of Infiniband HCAs
```

## drivers/infiniband/ulp/xsigo/Kconfig
```kconfig
source "drivers/infiniband/ulp/xsigo/xscore/Kconfig"
source "drivers/infiniband/ulp/xsigo/xsvnic/Kconfig"
source "drivers/infiniband/ulp/xsigo/xsvhba/Kconfig"
source "drivers/infiniband/ulp/xsigo/xve/Kconfig"
```

## drivers/infiniband/ulp/xsigo/xscore/Kconfig
```kconfig
config INFINIBAND_XSCORE
	tristate "Xsigo fabric support for InfiniBand devices"
	depends on NETDEVICES && INET && INFINIBAND
	---help---
	  Support for Xsigo fabric for Infiniband devices. This will enable
          Infiniband data transfer through Xsigo director.
```

## drivers/infiniband/ulp/xsigo/xsvhba/Kconfig
```kconfig
config INFINIBAND_XSVHBA
        tristate "Xsigo Virtual HBA"
        depends on INFINIBAND_XSCORE
        ---help---
	  Support for the Xsigo virtual HBA allowing SAN
	  Connectivity.

config VHBA_DEBUG
        bool "Xsigo Virtual HBA debugging" if EMBEDDED
        depends on INFINIBAND_XSVHBA
        default y
        ---help---
          This option causes debugging code to be compiled into the
          Xsigo xsvhba driver.  The output can be turned on via the
          vhba_debug_level module parameter (which can also be
          after the driver is loaded through sysfs).
```

## drivers/infiniband/ulp/xsigo/xsvnic/Kconfig
```kconfig
config INFINIBAND_XSVNIC
        tristate "Xsigo Virtual NIC"
        depends on INFINIBAND_XSCORE
        ---help---
          Support for the Xsigo vNIC Functionality.
```

## drivers/infiniband/ulp/xsigo/xve/Kconfig
```kconfig
config INFINIBAND_XVE
	tristate "Xsigo Virtual Ethernet"
	depends on INFINIBAND_XSCORE && NETDEVICES && INET && (IPV6 || IPV6=n)
	select INET_LRO
	---help---
	  Support for the Xsigo Virtual Ethernet (XVE) protocol,
	  Allowing private connectivity between servers using
	  Fabric switched Traffic.

config INFINIBAND_XVE_CM
	bool "Xsigo Virtual Ethernet Connected Mode support"
	depends on INFINIBAND_XVE
	default n
	---help---
	  This option enables support for XVE connected mode.

	  WARNING: Enabling connected mode will trigger some packet
	  drops for multicast and UD mode traffic from this interface,
	  unless you limit mtu for these destinations to 2030.

config INFINIBAND_XVE_DEBUG
	bool "Xsigo Virtual Ethernet debugging" if EMBEDDED
	depends on INFINIBAND_XVE
	default y
	---help---
	  This option causes debugging code to be compiled into the
	  XVE driver.  The output can be turned on via the
	  debug_level and mcast_debug_level module parameters (which
	  can also be set after the driver is loaded through sysfs).

	  This option also creates a directory tree under xve/ in
	  debugfs, which contains files that expose debugging
	  information about IB multicast groups used by the XVE
	  driver.

config INFINIBAND_XVE_DEBUG_DATA
	bool "Xsigo Virtual Ethernet data path debugging"
	depends on INFINIBAND_XVE_DEBUG
	---help---
	  This option compiles debugging code into the data path
	  of the XVE driver.  The output can be turned on via the
	  data_debug_level module parameter; however, even with output
	  turned off, this debugging code will have some performance
	  impact.
```

## drivers/misc/uek/Kconfig
```kconfig
# SPDX-License-Identifier: GPL-2.0+
#

config UEK_MISC
	bool "Misc UEK out-of-tree support"
	default y
	help
	  This option allows to self-optimize the kernel for Oracle
	  systems.
```

## drivers/mtd/nand/cavium/Kconfig
```kconfig
#
# Cavium OcteonTX Nand flash controller and BCH/copy engine
#
config MTD_NAND_CAVIUM
        tristate "Support for NAND on Cavium Octeon TX SOCs"
        depends on PCI && HAS_DMA && (ARM64 || COMPILE_TEST)
	default MTD_NAND if ARCH_THUNDER
	default N
        help
          Enables support for NAND Flash found some Cavium Octeon TX SOCs.
	  Only one of the possible 8 NAND chips is currently supported.
	  Either software ECC or the hardware BCH engine may be used.

	  To compile this as a module, choose M here.

config CAVIUM_BCH
	tristate "Cavium BCH driver"
	depends on MTD_NAND_CAVIUM || COMPILE_TEST
	depends on PCI_MSI && 64BIT
	default MTD_NAND_CAVIUM
	help
	  Support for Cavium BCH block found in octeon-tx series of
	  processors.
	  Currently used for hardware assist to MTD_NAND_CAVIUM,
	  potentially also usable as a general dma_engine.

	  To compile this as a module, choose M here.
```

## drivers/net/eipoib/Kconfig
```kconfig
config E_IPOIB
	tristate "Ethernet over IPoIB support"
	depends on PCI && INFINIBAND && INFINIBAND_ADDR_TRANS
	help
	  Ethernet over IPoIB functionality.
```

## drivers/net/ethernet/marvell/octeontx2/Kconfig
```kconfig
# SPDX-License-Identifier: GPL-2.0-only
#
# Marvell OcteonTX2 drivers configuration
#

config OCTEONTX2_MBOX
	tristate

config OCTEONTX2_AF
	tristate "Marvell OcteonTX2 RVU Admin Function driver"
	select OCTEONTX2_MBOX
	select NET_DEVLINK
	depends on (64BIT && COMPILE_TEST) || ARM64
	help
	  This driver supports Marvell's OcteonTX2 Resource Virtualization
	  Unit's admin function manager which manages all RVU HW resources
	  and provides a medium to other PF/VFs to configure HW. Should be
	  enabled for other RVU device drivers to work.

config NDC_DIS_DYNAMIC_CACHING
	bool "Disable caching of dynamic entries in NDC"
	depends on OCTEONTX2_AF
	default n
	---help---
	  This config option disables caching of dynamic entries such as NIX SQEs
	  , NPA stack pages etc in NDC. Also locks down NIX SQ/CQ/RQ/RSS and
	  NPA Aura/Pool contexts.

config OCTEONTX2_PF
	tristate "Marvell OcteonTX2 NIC Physical Function driver"
	select OCTEONTX2_MBOX
	select NET_DEVLINK
	select DIMLIB
	depends on PCI
	help
	  This driver supports Marvell's OcteonTX2 Resource Virtualization
	  Unit's physical function NIC driver.

config OCTEONTX2_VF
	tristate "Marvell OcteonTX2 NIC Virtual Function driver"
	depends on OCTEONTX2_PF
	help
	  This driver supports Marvell's OcteonTX2 NIC virtual function.

config OCTEONTX2_BPHY_RFOE_NETDEV
	tristate "OcteonTX2 BPHY RFOE netdev driver"
	depends on ARM64
	help
	  This driver provides support for processing packets received/sent by
	  BPHY RFOE MHAB such as eCPRI control, PTP and other ethernet packets
	  in Linux kernel. The rest of packets are processed by ODP application.
```

## drivers/net/ethernet/mellanox/mlx4_vnic/Kconfig
```kconfig
config MLX4_VNIC
	tristate "Mellanox Technologies VNIC support"
	depends on PCI && INFINIBAND && INFINIBAND_ADDR_TRANS
	select MLX4_CORE
	help
	  Mellanox Technologies VNIC functionality.


config MLX4_VNIC_DEBUG
	bool "Mellanox Technologies VNIC debugging"
	depends on MLX4_VNIC
	help
	  This option causes debugging code to be compiled into
	  the mlx4_vnic driver.
```

## drivers/net/ethernet/mellanox/mstflint_access/Kconfig
```kconfig
config MSTFLINT_ACCESS
        tristate "Mellanox Technologies MSTFLINT Secure Boot Access support"
        depends on PCI
        help
          Mellanox Technologies MSTFLINT_ACCESS functionality.
```

## drivers/net/ethernet/oracle/Kconfig
```kconfig
#
# Oracle network device configuration
#

config NET_VENDOR_ORACLE
	bool "Oracle network devices"
	default y
	---help---
	  If you have a network (Ethernet) card belonging to this class, say Y
	  and read the Ethernet-HOWTO, available from
	  <http://www.tldp.org/docs.html#howto>.

	  Note that the answer to this question doesn't directly affect the
	  kernel: saying N will just cause the configurator to skip all
	  the questions about Intel cards. If you say Y, you will be asked for
	  your specific card in the following questions.

if NET_VENDOR_ORACLE

config HXGE
        tristate "Sun Microsystems 10Gb Ethernet Adapter "
        depends on PCI
        ---help---
          This driver supports the Hydra 10Gb Ethernet driver.


config HXGE_NAPI
        bool "Use Rx Polling (NAPI)"
        depends on HXGE
        help
          NAPI is a new driver API designed to reduce CPU and interrupt load
          when the driver is receiving lots of packets from the card. It is
          still somewhat experimental and thus not yet enabled by default.

          If your estimated Rx load is 10kpps or more, or if the card will be
          deployed on potentially unfriendly networks (e.g. in a firewall),
          then say Y here.

          See <file:Documentation/networking/NAPI_HOWTO.txt> for more
          information.

          If in doubt, say N.

config SXGE 
	tristate "SXGE SOL ethernet driver "
	depends on PCI
	---help---
	This driver supports the SXGE SOL 40Gb Ethernet driver.  

config SXGEVF 
	tristate "SXGEVF SOL ethernet driver "
	depends on PCI
	---help---
	This driver supports the SXGEVF SOL 40Gb Ethernet driver.  

endif # NET_VENDOR_ORACLE
```

## drivers/net/ethernet/oracle/hxge/Kconfig
```kconfig
config NET_HXGE 
        tristate "Sun Microsystems 10Gb Ethernet Adapter "
        depends on PCI
        ---help---
          This driver supports the Hydra 10Gb Ethernet driver.  


config HXGE_NAPI
        bool "Use Rx Polling (NAPI)"
        depends on HXGE
        help
          NAPI is a new driver API designed to reduce CPU and interrupt load
          when the driver is receiving lots of packets from the card. It is
          still somewhat experimental and thus not yet enabled by default.

          If your estimated Rx load is 10kpps or more, or if the card will be
          deployed on potentially unfriendly networks (e.g. in a firewall),
          then say Y here.

          See <file:Documentation/networking/NAPI_HOWTO.txt> for more
          information.

          If in doubt, say N.
```

## drivers/net/sxge/Kconfig
```kconfig
config SXGE 
        tristate "SXGE SOL ethernet driver "
        depends on PCI
        ---help---
          This driver supports the SXGE SOL 40Gb Ethernet driver.  
```

## drivers/net/sxgevf/Kconfig
```kconfig
config SXGEVF 
        tristate "SXGEVF SOL ethernet driver "
        depends on PCI
        ---help---
          This driver supports the SXGEVF SOL 40Gb Ethernet driver.  
```

## drivers/perf/Kconfig
```kconfig
#
# Performance Monitor Drivers
#

menu "Performance monitor support"
	depends on PERF_EVENTS

config ARM_PMU
	depends on ARM || ARM64
	bool "ARM PMU framework"
	default y
	help
	  Say y if you want to use CPU performance monitors on ARM-based
	  systems.

config ARM_PMU_ACPI
	depends on ARM_PMU && ACPI
	def_bool y

config QCOM_L2_PMU
	bool "Qualcomm Technologies L2-cache PMU"
	depends on ARCH_QCOM && ARM64 && ACPI
	  help
	  Provides support for the L2 cache performance monitor unit (PMU)
	  in Qualcomm Technologies processors.
	  Adds the L2 cache PMU into the perf events subsystem for
	  monitoring L2 cache events.

config QCOM_L3_PMU
	bool "Qualcomm Technologies L3-cache PMU"
	depends on ARCH_QCOM && ARM64 && ACPI
	select QCOM_IRQ_COMBINER
	help
	   Provides support for the L3 cache performance monitor unit (PMU)
	   in Qualcomm Technologies processors.
	   Adds the L3 cache PMU into the perf events subsystem for
	   monitoring L3 cache events.

config XGENE_PMU
        depends on ARCH_XGENE
        bool "APM X-Gene SoC PMU"
        default n
        help
          Say y if you want to use APM X-Gene SoC performance monitors.

config ARM_SPE_PMU
	tristate "Enable support for the ARMv8.2 Statistical Profiling Extension"
	depends on ARM64
	help
	  Enable perf support for the ARMv8.2 Statistical Profiling
	  Extension, which provides periodic sampling of operations in
	  the CPU pipeline and reports this via the perf AUX interface.

config ARM_SMMU_V3_PMU
	 tristate "ARM SMMUv3 Performance Monitors Extension"
	 depends on ARM64 && ARM_SMMU_V3
	   help
	   Provides support for the ARM SMMUv3 Performance Monitor Counter
	   Groups (PMCG), which provide monitoring of transactions passing
	   through the SMMU and allow the resulting information to be filtered
	   based on the Stream ID of the corresponding master.

endmenu
```

## drivers/phy/pensando/Kconfig
```kconfig
#
# Phy drivers for Pensando platforms
#
config PHY_PENSANDO_CAPRI_EMMC
	tristate "Pensando Capri EMMC PHY Driver"
	depends on ARCH_PENSANDO_CAPRI_SOC && OF
	select GENERIC_PHY
	help
	  Enable this to support the Pensando EMMC PHY.
```

## drivers/platform/arista-sonic/Kconfig
```kconfig
# SPDX-License-Identifier: GPL-2.0-only
#
# Kconfig for Arista SONiC SCD driver
#

config ARISTA_SCD_DRIVER
	tristate "Arista SONiC SCD driver"
	depends on NETDEVICES && ETHERNET
	depends on PCI
	depends on I2C
	depends on HWMON
	depends on LEDS_CLASS
	help
	  Enable the Arista SONiC SCD driver imported under
	  drivers/platform/arista-sonic from:

	    https://github.com/aristanetworks/sonic

	  This option builds the SONiC SCD driver, which relies on
	  PCI, I2C, HWMON, and LED subsystems.

	  Say Y here to build it into the kernel, or M to build it as a module.
```

## drivers/platform/bcm-hsdk-gpl/Kconfig
```kconfig
# SPDX-License-Identifier: GPL-2.0-only

menuconfig BCM_HSDK_GPL
        bool "Broadcom HSDK drivers"
        depends on X86
        help
          Say Y here to get to see options for BCM_HSDK_GPL kernel drivers.
          This option alone does not add any kernel code.
          If you say N, all options in this submenu will be skipped and disabled.

if BCM_HSDK_GPL

config BCM_HSDK_BDE
	tristate "Broadcom HSDK BDE core"
	depends on PCI
	depends on HAS_DMA
	help
	  Build the Broadcom NG BDE core and device access layer.

config BCM_HSDK_KNET
	tristate "Broadcom HSDK KNET"
	depends on NETDEVICES
	depends on BCM_HSDK_BDE
	help
	  Build the Broadcom packet I/O network driver together with the
	  BCMCNET DMA back end.

config BCM_HSDK_KNETCB
	tristate "Broadcom HSDK KNET callbacks"
	depends on BCM_HSDK_KNET
	help
	  Build the NGKNET callback driver.

config BCM_HSDK_GENL_PACKET
	tristate "Broadcom HSDK genl-packet transport"
	help
	  Build the generic netlink transport used by BCMGENL.

config BCM_HSDK_BCMGENL
	tristate "Broadcom HSDK BCMGENL"
	depends on BCM_HSDK_KNET
	depends on BCM_HSDK_GENL_PACKET
	help
	  Build the Broadcom generic netlink callback driver.

config BCM_HSDK_EDK
	tristate
	depends on BCM_HSDK_BDE

config BCM_HSDK_PTPCLOCK
	tristate "Broadcom HSDK PTP clock"
	depends on PTP_1588_CLOCK
	depends on BCM_HSDK_KNET
	select BCM_HSDK_EDK
	help
	  Build the Broadcom PTP clock driver.
	  This also enables the internal EDK helper required by the
	  timestamp log path.

config BCM_HSDK_ST
	tristate "Broadcom HSDK streaming telemetry"
	depends on BCM_HSDK_BDE
	help
	  Build the Broadcom streaming telemetry driver.

endif  #BCM_HSDK_GPL
```
