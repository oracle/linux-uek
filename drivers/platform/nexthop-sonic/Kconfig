## drivers/platform/nexthop-sonic/Kconfig
```kconfig
config NEXTHOP_SONIC_DRIVERS
	tristate "Nexthop SONiC platform drivers"
	depends on X86_64 || COMPILE_TEST
	depends on I2C
	depends on HWMON
	depends on GPIOLIB
	depends on NVMEM
	select REGMAP_I2C
	select CRC8
	help
	  Enable platform-specific hardware monitoring drivers used by
	  Nexthop SONiC switches. This includes Nexthop's PMBus core and
	  drivers for ADM1266, Renesas ISL68137-family, Infineon TDA38740-
	  family, and TI TMP464-family devices.

	  Say M to build each driver as a separate module.

config NEXTHOP_SONIC_FPGA_ALGO
	tristate "Nexthop SONiC custom FPGA I2C algorithm"
	depends on PDDF_MULTIFPGAPCI_I2C
	default NEXTHOP_SONIC_DRIVERS
	help
	  Enable the Nexthop AXI IIC algorithm used by the PDDF multi-FPGA
	  PCI I2C adapter driver.

config NEXTHOP_SONIC_MDIO_ALGO
	tristate "Nexthop SONiC custom FPGA MDIO algorithm"
	depends on PDDF_MULTIFPGAPCI_MDIO
	default NEXTHOP_SONIC_DRIVERS
	help
	  Enable the Nexthop Clause 45 MDIO algorithm used by the PDDF
	  multi-FPGA PCI MDIO driver.
```

## drivers/platform/pddf-sonic/Kconfig
```kconfig
# SPDX-License-Identifier: GPL-2.0-only

menu "SONiC PDDF drivers"

config PDDF_CLIENT
	tristate "PDDF generic client support"
	depends on I2C
	depends on HWMON
	help
	  Enable the generic PDDF client support module used by SONiC
	  platform-specific PDDF drivers.

config PDDF_CPLD
	tristate "PDDF CPLD support"
	depends on PDDF_CLIENT
	help
	  Enable PDDF CPLD platform data and I2C driver support.

config PDDF_CPLDMUX
	tristate "PDDF CPLD I2C mux support"
	depends on PDDF_CLIENT
	depends on I2C_MUX
	depends on PCI
	help
	  Enable PDDF CPLD-backed I2C mux platform data and driver support.

config PDDF_FPGAI2C
	tristate "PDDF FPGA I2C support"
	depends on PDDF_CLIENT
	help
	  Enable PDDF FPGA I2C platform data and I2C driver support.

config PDDF_FPGAPCI
	tristate "PDDF FPGA PCI support"
	depends on PDDF_CLIENT
	depends on PCI
	help
	  Enable PDDF PCI FPGA platform data, driver, and bundled Xilinx
	  device 7021 I2C-bus algorithm support.

config PDDF_MULTIFPGAPCI
	tristate "PDDF multi-FPGA PCI support"
	depends on PDDF_CLIENT
	depends on PCI
	help
	  Enable the core PDDF support for systems with multiple PCI FPGAs.

config PDDF_MULTIFPGAPCI_GPIO
	tristate "PDDF multi-FPGA PCI GPIO support"
	depends on PDDF_MULTIFPGAPCI
	depends on GPIOLIB
	help
	  Enable PDDF GPIO support for multi-FPGA PCI platforms.

config PDDF_MULTIFPGAPCI_I2C
	tristate "PDDF multi-FPGA PCI I2C support"
	depends on PDDF_MULTIFPGAPCI
	help
	  Enable PDDF I2C adapter support for multi-FPGA PCI platforms.

config PDDF_MULTIFPGAPCI_I2C_XIIC
	tristate "PDDF multi-FPGA PCI Xilinx I2C support"
	depends on PDDF_MULTIFPGAPCI
	depends on I2C_XILINX
	help
	  Enable PDDF Xilinx XIIC adapter support for multi-FPGA PCI platforms.

config PDDF_MULTIFPGAPCI_MDIO
	tristate "PDDF multi-FPGA PCI MDIO support"
	depends on PDDF_MULTIFPGAPCI
	depends on NETDEVICES
	depends on PHYLIB
	help
	  Enable PDDF MDIO bus support for multi-FPGA PCI platforms.

config PDDF_MULTIFPGAPCI_SPI
	tristate "PDDF multi-FPGA PCI SPI support"
	depends on PDDF_MULTIFPGAPCI
	depends on SPI_MASTER
	depends on SPI_XILINX
	help
	  Enable PDDF SPI controller support for multi-FPGA PCI platforms.

config PDDF_XCVR
	tristate "PDDF transceiver support"
	depends on PDDF_CLIENT
	help
	  Enable PDDF transceiver platform data and driver support.

config PDDF_MUX
	tristate "PDDF I2C mux client support"
	depends on PDDF_CLIENT
	help
	  Enable PDDF I2C mux client platform data support.

config PDDF_GPIO
	tristate "PDDF GPIO expander client support"
	depends on PDDF_CLIENT
	depends on GPIOLIB
	help
	  Enable PDDF GPIO expander client platform data support.

config PDDF_PSU
	tristate "PDDF PSU support"
	depends on PDDF_CLIENT
	help
	  Enable PDDF PSU platform data and driver support.

config PDDF_FAN
	tristate "PDDF fan support"
	depends on PDDF_CLIENT
	help
	  Enable PDDF fan platform data and driver support.

config PDDF_LED
	tristate "PDDF LED support"
	depends on PDDF_CLIENT
	depends on LEDS_CLASS
	help
	  Enable PDDF LED support.

config PDDF_SYSSTATUS
	tristate "PDDF system status support"
	depends on PDDF_CLIENT
	help
	  Enable PDDF system status platform data support.

config PDDF_SPI
	tristate "PDDF SPI device support"
	depends on PDDF_CLIENT
	depends on SPI_MASTER
	help
	  Enable PDDF support for creating and deleting SPI devices.

endmenu
```

## drivers/soc/pensando/Kconfig
```kconfig
if ARCH_PENSANDO

menu "Pensando SoC drivers"

choice
    prompt "SoC Select"
    default ARCH_PENSANDO_ELBA_SOC
    help
      Select the AMD Pensando SoC variant this kernel is built for.
      The Elba, Giglio and Salina SoCs share most drivers but differ
      in memory, PCIe and peripheral layout, so exactly one must be
      chosen to pull in the correct register maps and device tree.

config ARCH_PENSANDO_ELBA_SOC
	bool "Elba SoC"
	select ARCH_HAS_DMA_OPS
	select REGMAP_SPI
	help
	  Support for the AMD Pensando Elba SoC, a multi-core ARMv8
	  data-processing unit (DPU). Selects the Elba register maps,
	  DMA operations and the SPI regmap used by the on-board CPLD
	  and the rest of the Pensando SoC service drivers.

config ARCH_PENSANDO_GIGLIO_SOC
	bool "Giglio SoC"
	help
	  Support for the AMD Pensando Giglio SoC, a multi-core ARMv8
	  data-processing unit (DPU). Selects the Giglio register maps
	  and peripheral layout shared with the other Pensando SoC
	  service drivers.

config ARCH_PENSANDO_SALINA_SOC
	bool "Salina SoC"
	select ARCH_HAS_DMA_OPS
	help
	  Support for the AMD Pensando Salina SoC, a multi-core ARMv8
	  data-processing unit (DPU) with four DDR5 memory controllers.
	  Selects the Salina register maps and DMA operations used by
	  the Pensando SoC service drivers.
endchoice

config PENSANDO_SOC_CAPMEM
	tristate "/dev/capmem driver for the Pensando SoCs"
	depends on OF
	default y
	help
	  Provides the /dev/capmem character device that lets userspace
	  mmap the large reserved DMA memory regions handed off by U-Boot
	  on the Pensando SoCs. Used by the dataplane and pciemgr tools
	  to map coherent and non-coherent SoC memory. Say Y, or M to
	  build it as a module.

config PENSANDO_SOC_CAPMEM_HUGEPAGE
	tristate "Enable hugepage support in capmem"
	select TRANSPARENT_HUGEPAGE
	default n
	help
	  Enable transparent hugepage backing for the capmem driver so
	  that mappings of the reserved SoC memory regions use PMD-sized
	  pages. This lowers TLB pressure for the large dataplane buffers
	  at the cost of pulling in TRANSPARENT_HUGEPAGE. If unsure, say
	  N.

config PENSANDO_SOC_PCIE
	tristate "PCIe driver for Pensando SoCs"
	depends on OF
	default y
	help
	  Provides the kernel-assist interface used by the userspace
	  pciemgr to drive the Pensando SoC PCIe controller. Handles the
	  privileged register access, reset and SError hooks that pciemgr
	  cannot perform from userspace. Say Y, or M to build it as a
	  module.

config PENSANDO_SOC_RSTCAUSE
	tristate "Pensando reset cause driver"
	depends on OF
	default y
	help
	  Records and exports the cause of the last SoC reset (watchdog,
	  panic, power-on or software reboot) through sysfs and updates
	  the persistent reset-cause register on reboot and panic. Useful
	  for diagnosing unexpected restarts in the field. Say Y, or M to
	  build it as a module.

config PENSANDO_SOC_CRASH
	tristate "Pensando crash driver"
	depends on OF
	default y
	help
	  On panic this driver dumps the kernel log buffer into a
	  reserved flash region on the Pensando SoC so the crash can be
	  retrieved and decoded after the next boot. Provides post-mortem
	  diagnostics for headless DPU deployments. Say Y, or M to build
	  it as a module.

config PENSANDO_SOC_BSM
	bool "Pensando SoC Boot State Machine"
	depends on OF
	default y
	help
	  Exposes the Pensando SoC Boot State Machine (BSM) state through
	  sysfs, reporting the firmware boot stage and progress recorded
	  by the boot ROM and U-Boot. Used to track and debug the
	  multi-stage secure boot flow. If unsure, say Y.

config PENSANDO_SOC_BSM_ENABLE
	bool "Enable the Boot State Machine in the kernel"
        depends on PENSANDO_SOC_BSM
	help
	  Re-arm the Boot State Machine when the kernel starts so that a
	  subsequent unexpected reset is detected and recovered by the
	  boot firmware. Only takes effect when PENSANDO_SOC_BSM is
	  enabled. If unsure, say N.

config PENSANDO_SOC_PENFW
	bool "Pensando penfw driver"
	default n
	help
	  Provides the penfw character device and sysfs interface used to
	  query and update the secure-boot configuration of the Pensando
	  SoC through Arm SMC calls into the secure firmware. Used by
	  provisioning tools to read fuse and key state. If unsure, say
	  N.

config PENSANDO_SOC_SBUS
	tristate "Pensando sbus read/write driver"
	depends on OF
	default y
	help
	  Provides a character device for indirect read/write access to
	  the Pensando SoC serial bus (SBus), used to reach the SerDes
	  and other analog IP blocks for tuning and diagnostics. Say Y,
	  or M to build it as a module.

endmenu

endif
```
