// SPDX-License-Identifier: (GPL-2.0-only or BSD-2-Clause)
/*
 * Device Tree file for AMD Pensando Elba Board.
 *
 * Copyright 2020-2022 Advanced Micro Devices, Inc.
 */

/dts-v1/;

#include "giglio.dtsi"
#include "elba-16core.dtsi"
#include "giglio-asic-common.dtsi"
#include "elba-flash-parts.dtsi"
#include "elba-asic-memory.dtsi"
#include "elba-mdev.dtsi"

/ {
	model = "AMD Pensando Giglio Board";
	compatible = "amd, pensando-giglio-ginestra", "amd,pensando-giglio";

	aliases {
		serial0 = &uart0;
		spi0 = &spi0;
		spi1 = &qspi;
	};

	chosen {
		stdout-path = "serial0:115200n8";
	};
};
