// SPDX-License-Identifier: GPL-2.0

/dts-v1/;

/ {
	model = "Giglio ASIC Board";
	compatible = "pensando,giglio";

	aliases {
		serial0 = &uart0;
		spi0 = &spi0;
		spi1 = &qspi;
	};

	chosen {
		stdout-path = "serial0:115200n8";
	};
};

#include "giglio.dtsi"
#include "elba-16core.dtsi"
#include "elba-16core-spin-table.dtsi"
#include "giglio-asic-common.dtsi"
#include "elba-flash128-parts.dtsi"
#include "elba-asic-memory.dtsi"
#include "elba-mdev.dtsi"
