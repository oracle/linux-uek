## Documentation/devicetree/bindings/mmc/cdns,sdhci.yaml
```yaml
# SPDX-License-Identifier: GPL-2.0-only OR BSD-2-Clause
%YAML 1.2
---
$id: http://devicetree.org/schemas/mmc/cdns,sdhci.yaml#
$schema: http://devicetree.org/meta-schemas/core.yaml#

title: Cadence SD/SDIO/eMMC Host Controller (SD4HC, SD6HC)

maintainers:
  - Masahiro Yamada <yamada.masahiro@socionext.com>
  - Piotr Sroka <piotrs@cadence.com>

allOf:
  - $ref: mmc-controller.yaml

properties:
  compatible:
    oneOf:
      - items:
          - enum:
              - amd,pensando-elba-sd4hc
              - microchip,mpfs-sd4hc
              - socionext,uniphier-sd4hc
          - const: cdns,sd4hc

      - items:
          - const: marvell,cdns-sd6hc

  reg:
    maxItems: 1

  interrupts:
    maxItems: 1

  clocks:
    maxItems: 1

  # PHY DLL input delays:
  # They are used to delay the data valid window, and align the window to
  # sampling clock. The delay starts from 5ns (for delay parameter equal to 0)
  # and it is increased by 2.5ns in each step.

  cdns,phy-input-delay-sd-highspeed:
    description: Value of the delay in the input path for SD high-speed timing
    $ref: "/schemas/types.yaml#/definitions/uint32"
    minimum: 0
    maximum: 0x1f

  cdns,phy-input-delay-legacy:
    description: Value of the delay in the input path for legacy timing
    $ref: "/schemas/types.yaml#/definitions/uint32"
    minimum: 0
    maximum: 0x1f

  cdns,phy-input-delay-sd-uhs-sdr12:
    description: Value of the delay in the input path for SD UHS SDR12 timing
    $ref: "/schemas/types.yaml#/definitions/uint32"
    minimum: 0
    maximum: 0x1f

  cdns,phy-input-delay-sd-uhs-sdr25:
    description: Value of the delay in the input path for SD UHS SDR25 timing
    $ref: "/schemas/types.yaml#/definitions/uint32"
    minimum: 0
    maximum: 0x1f

  cdns,phy-input-delay-sd-uhs-sdr50:
    description: Value of the delay in the input path for SD UHS SDR50 timing
    $ref: "/schemas/types.yaml#/definitions/uint32"
    minimum: 0
    maximum: 0x1f

  cdns,phy-input-delay-sd-uhs-ddr50:
    description: Value of the delay in the input path for SD UHS DDR50 timing
    $ref: "/schemas/types.yaml#/definitions/uint32"
    minimum: 0
    maximum: 0x1f

  cdns,phy-input-delay-mmc-highspeed:
    description: Value of the delay in the input path for MMC high-speed timing
    $ref: "/schemas/types.yaml#/definitions/uint32"
    minimum: 0
    maximum: 0x1f

  cdns,phy-input-delay-mmc-ddr:
    description: Value of the delay in the input path for eMMC high-speed DDR timing

  # PHY DLL clock delays:
  # Each delay property represents the fraction of the clock period.
  # The approximate delay value will be
  # (<delay property value>/128)*sdmclk_clock_period.
    $ref: "/schemas/types.yaml#/definitions/uint32"
    minimum: 0
    maximum: 0x1f

  cdns,phy-dll-delay-sdclk:
    description: |
      Value of the delay introduced on the sdclk output for all modes except
      HS200, HS400 and HS400_ES.
    $ref: "/schemas/types.yaml#/definitions/uint32"
    minimum: 0
    maximum: 0x7f

  cdns,phy-dll-delay-sdclk-hsmmc:
    description: |
      Value of the delay introduced on the sdclk output for HS200, HS400 and
      HS400_ES speed modes.
    $ref: "/schemas/types.yaml#/definitions/uint32"
    minimum: 0
    maximum: 0x7f

  cdns,phy-dll-delay-strobe:
    description: |
      Value of the delay introduced on the dat_strobe input used in
      HS400 / HS400_ES speed modes.
    $ref: "/schemas/types.yaml#/definitions/uint32"
    minimum: 0
    maximum: 0x7f

required:
  - compatible
  - reg
  - interrupts
  - clocks

  - if:
      properties:
        compatible:
          contains:
            const: marvell,cdns-sd6hc

    then:
      properties:
        marvell,iocell-input-delay-ps:
          description: Delay in ps across the input IO cells

        marvell,iocell-output-delay-ps:
          description: Delay in ps across the output IO cells

        marvell,delay-element-ps:
          description: Delay element in ps used for calculating phy timings

        marvell,read-dqs-cmd-delay-ps:
          description: Command delay used in HS200 tuning

        marvell,tune-val-start-ps:
          description: Staring value of data delay used in HS200 tuning

        marvell,tune-val-step-ps:
          description: Incremental value of data delay used in HS200 tuning

      required:
        - marvell,iocell-input-delay-ps
        - marvell,iocell-output-delay-ps
        - marvell,delay-element-ps
        - marvell,read-dqs-cmd-delay-ps
        - marvell,tune-val-start-ps
        - marvell,tune-val-step-ps

unevaluatedProperties: false

examples:
  - |
    emmc: mmc@5a000000 {
        compatible = "socionext,uniphier-sd4hc", "cdns,sd4hc";
        reg = <0x5a000000 0x400>;
        interrupts = <0 78 4>;
        clocks = <&clk 4>;
        bus-width = <8>;
        mmc-ddr-1_8v;
        mmc-hs200-1_8v;
        mmc-hs400-1_8v;
        cdns,phy-dll-delay-sdclk = <0>;
    };
```

## Documentation/devicetree/bindings/mmc/mmcoops.txt
```
Mmcoops oops/panic logger
=========================

Introduction
------------

Mmcoops is an oops/panic logger that write its logs to MMC before the system crashes.
Introduction and concept are similar to other oops loggers.
(Refer to Documentation/ramoops.txt)

Required Properties:
--------------------

* compatible: should be "mmcoops"
* ``start-offset``: block-offset for start.
* ``size``: the number of block to write oopses and panics.

Example::

	mmcoops {
		compatible = "mmcoops";
		start-offset = <14680064>;	/* 14680064 * 512B = 7GB */
		size = <20>;			/* 20 * 512B = 10KiB */
	};


Dump format
-----------

The data dump begins with a header, currently defined as ``====``, the dump then
continues with the actual data. It is written in raw ASCI format.

Reading the data
----------------

After reboot, the last log can be gathered with bellow command::

 #dd if=/dev/mmcblk0 of=/tmp/dump.log skip=14680064 count=20; cat /tmp/dump.log

- skip is the ``start-offset`` declared in device tree
- count is the ``size`` value declared in device tree


Choosing mmcblk used for dumps via sysfs
----------------------------------------

In order to bind different mmc device to mmc_oops the mmcX:000Y can be unbind
and then bind to mmc_oops::

 # ls -al /sys/bus/mmc/drivers/mmcblk
 drwxr-xr-x 2 root root    0 Mar 10 23:05 .
 drwxr-xr-x 4 root root    0 Mar 10 23:05 ..
 --w------- 1 root root 4096 Mar 10 23:05 bind
 lrwxrwxrwx 1 root root    0 Mar 10 23:05 mmc0:0001 -> ../../../../devices/platform/ap807/ap807:config-space@f0000000/f06e0000.sdhci/mmc_host/mmc0/mmc0:0001
 lrwxrwxrwx 1 root root    0 Mar 10 23:05 mmc2:0007 -> ../../../../devices/platform/cp2/cp2:config-space/f6780000.sdhci/mmc_host/mmc2/mmc2:0007
 --w------- 1 root root 4096 Mar 10 23:05 uevent
 --w------- 1 root root 4096 Mar 10 23:05 unbin

 # echo mmc2:0007 > /sys/bus/mmc/drivers/mmcblk/unbind
 # echo mmc2:0007 > /sys/bus/mmc/drivers/mmc_oops/bind
 [  165.860185] mmc2: mmc_oops_card_set
 #
```

## Documentation/devicetree/bindings/net/cortina-cs4321.txt
```
Cortina CS4321 dual RXAIU/quad XAUI 10G Ethernet PHYs.  Each PHY
within the package is mostly independent and has the following
properties.  These phys do *not* implement the standard IEEE 802.3
clause 45 registers.

Required Properties:

- compatible : "cortina,cs4321" or "cortina,cs4318".
- reg : The address on the system management bus (MDIO/I2C/SPI address)
- cortina,host-mode : Either "rxaui" or "xaui", the protocol used to
  communicate with the Ethernet MAC.

Optional Properties:

- interrupts : One set of cells (per the interrupt-parent) for the
  interrupt line.
- interrupt-parent : Standard interrupt-parent property for the interrupt.

Example:

	phy0: ethernet-phy@4 {
		reg = <0x04>;
		compatible = "cortina,cs4318";
		interrupt-parent = <&gpio>;
		interrupts = <11 8>; /* Pin 11, active low */
		cortina,host-mode = "rxaui";
	};
```

## Documentation/devicetree/bindings/net/marvell-musdk-cma.txt
```
* Marvell MUSDK continuous memory allocation driver (BM)

Required properties:

- compatible: should be "marvell,musdk-cma".

Optional properties:

- dma-coherent

Example:

musdk_cma {
	compatible = "marvell,musdk-cma";
	dma-coherent;
};
```

## Documentation/devicetree/bindings/perf/arm_smmuv3_pmu.txt
```
* ARM SMMU-V3 PMU (Performance Monitor Extension)

Required properties:

- compatible:	(standard compatible string) should be:
		"arm,smmu-pmu-v3"

- reg: 		(standard registers property) physical address and
		size of the configuration registers blocks.

		SMMU-V3 PMU can have one or more Performance monitor
		counter Group (PMCG). Each PMCG have one 4K page and
		additional optional one more 4K page

- msi-parent: 	See the generic MSI binding described in
		devicetree/bindings/interrupt-controller/msi.txt
		for a description of the msi-parent property.
Example:

	smmupmcg0@30100000 {
		compatible = "arm,smmu-pmu-v3";

		/* Single configuration register page */
		reg = <0x30100000 0x1000>;
		msi-parent = <&its 0x10>;
	};

	smmupmcg0@830000100000 {
		compatible = "arm,smmu-pmu-v3";

		/* Additional optional configuration register page */
		reg = <0x30100000 0x1000>, <0x30110000 0x1000>;
		msi-parent = <&its 0x11>;
	};
```

## Documentation/devicetree/bindings/perf/marvell-cn10k-ddr.txt
```
* Marvell CN10k DDR performance monitor

Required properties:

- compatible: should be one of:
	"marvell,cn10k-ddr-pmu"

- reg: physical address and size

Example:

	ddrcpmu {
		compatible = "marvell,cn10k-ddr-pmu";
		reg = <0x87e1 0xc0000000 0x0 0x10000>;
	};
```

## Documentation/devicetree/bindings/perf/marvell-cn10k-tad-pmu.txt
```
* Marvell CN10K LLC-TAD performace monitor unit

Required properties:
- compatible: must be:
	"marvell,cn10k-tad-pmu"
- tad-cnt: number of tad pmu regions
- tad-page-size: size of entire tad block
- tad-pmu-page-size: size of one tad pmu region
- reg: physical address and size

Example:

/* Actual values updated by firmware at boot time */
tad_pmu {
	compatible = "marvell,cn10k-tad-pmu";
	tad-cnt = <1>;
	tad-page-size = <0x1000>;
	tad-pmu-page-size = <0x1000>;
	reg = <0x87e2 0x80000000 0x0 0x1000>;
};
```

## Documentation/devicetree/bindings/reset/amd,pensando-elbasr-reset.yaml
```yaml
# SPDX-License-Identifier: (GPL-2.0 OR BSD-2-Clause)
%YAML 1.2
---
$id: http://devicetree.org/schemas/reset/amd,pensando-elbasr-reset.yaml#
$schema: http://devicetree.org/meta-schemas/core.yaml#

title: AMD Pensando Elba SoC Reset Controller Device Tree Bindings

maintainers:
  - Brad Larson <blarson@amd.com>

description: |
  AMD Pensando Elba SoC reset controller driver which supports a resource
  controller connected to the Elba SoC over a SPI bus.  The Elba reset
  controller must be defined as a child node of the Elba SPI bus
  chip-select 0 node.

  See also:
  - dt-bindings/reset/amd,pensando-elba-reset.h

properties:
  $nodename:
    pattern: "^reset-controller@[0-9a-f]+$"

  compatible:
    const: amd,pensando-elbasr-reset

  reg:
    const: 0

  '#reset-cells':
    const: 1

required:
  - compatible
  - reg
  - '#reset-cells'

additionalProperties: false

examples:
  - |
    #include <dt-bindings/reset/amd,pensando-elba-reset.h>
    spi0 {
        #address-cells = <1>;
        #size-cells = <0>;
        num-cs = <4>;

        spi@0 {
          reg = <0>;
          #address-cells = <1>;
          #size-cells = <0>;

          rstc: reset-controller@0 {
            compatible = "amd,pensando-elbasr-reset";
            reg = <0>;
            #reset-cells = <1>;
          };
        };
    };

...
```

## Documentation/devicetree/bindings/thermal/octeontx-thermal.txt
```
* Octeon TX Thermal

This driver is for Octeon TX SoCs

Required properties:
- compatible : "marvell,octeontx-thermal"
- reg : Address range of the thermal registers

The reg properties should contain one range for the temperature sensor
registers.

Example:

	thermal@1180021000000 {
		compatible = "marvell,octeontx-thermal";
		reg = <0x1180021000000 0x1000000>;
	};
```

## Documentation/devicetree/bindings/thermal/octeontx2-thermal.txt
```
* Octeon TX2 Thermal

This driver is for Octeon TX2 SoCs

Required properties:
- compatible : "marvell,octeontx2-thermal"
- reg : Address range of the thermal registers

The reg properties should contain one range for the temperature sensor
registers.

Example:

	thermal@87e0c0000000 {
		compatible = "marvell,octeontx2-thermal";
		reg = <0x87e0c0000000 0x1000000>;
	};

	thermal@87e0c1000000 {
		compatible = "marvell,octeontx2-thermal";
		reg = <0x87e0c1000000 0x1000000>;
	};

	thermal@87e0c2000000 {
		compatible = "marvell,octeontx2-thermal";
		reg = <0x87e0c2000000 0x1000000>;
	};

	thermal@87e0c3000000 {
		compatible = "marvell,octeontx2-thermal";
		reg = <0x87e0c3000000 0x1000000>;
	};

	thermal@87e0c4000000 {
		compatible = "marvell,octeontx2-thermal";
		reg = <0x87e0c4000000 0x1000000>;
	};

	thermal@87e0c5000000 {
		compatible = "marvell,octeontx2-thermal";
		reg = <0x87e0c5000000 0x1000000>;
	};

	thermal@87e0c6000000 {
		compatible = "marvell,octeontx2-thermal";
		reg = <0x87e0c6000000 0x1000000>;
	};

	thermal@87e0c7000000 {
		compatible = "marvell,octeontx2-thermal";
		reg = <0x87e0c7000000 0x1000000>;
	};

	thermal@87e0c8000000 {
		compatible = "marvell,octeontx2-thermal";
		reg = <0x87e0c8000000 0x1000000>;
	};

	thermal@87e0c9000000 {
		compatible = "marvell,octeontx2-thermal";
		reg = <0x87e0c9000000 0x1000000>;
	};
```

## Kconfig
```kconfig
#
# For a description of the syntax of this configuration file,
# see Documentation/kbuild/kconfig-language.txt.
#
mainmenu "Linux/$ARCH $KERNELVERSION Kernel Configuration"

config SRCARCH
	string
	option env="SRCARCH"

# special hack for UEK-OL6 to allow special kABI hacks
config SIMULATE_GCC44_KABI
	bool "Simulate the gcc 4.4 kABI"
	default n

source "arch/$SRCARCH/Kconfig"
```
