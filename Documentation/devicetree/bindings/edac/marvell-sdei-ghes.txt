## Documentation/devicetree/bindings/edac/marvell-sdei-ghes.txt
```
OcteonTX2 / CN10K SoC EDAC node
==================================

This driver uses the EDAC framework to implement the 
Marvell OcteonTX2/CN10K (CN10K) SoC EDAC driver.
Counts and corrects single-bit errors and counts
double-bit errors, which are uncorrectable.
Driver handle SECDED notification from SDEI call
after firmware first GHES interrupt handling.

Marvell OcteonTX2/CN10K SOC sdei-ghes node
It is defined to describe GHES resources for SECDED.

The following error sources are supported:

  MDC     - OcteonTX2/CN10K Memory Diagnostic Controller
  MCC     - OcteonTX2 Memory Common Controller
  LMC     - OcteonTX2 Local Memory DDR4 Controller
  DSS     - CN10K DDR5 Memory Controller
  TAD     - CN10K Cache Memory Controller
  CORE[i] - CN10K ARM core processors

Device Tree sdei-ghes binding
-----------------------------

Required properties:
- compatible: Shall be "marvell,sdei-ghes".

Required properties for GHES subnode:
- reg		: Shall contain three entries, one for each of:
		  - GHES Error Status Address (ACPI 4.0a, sec 17.3.2.6)
		  - GHES Error Status Block   (ACPI 4.0a, sec 17.3.2.6.1)
		  - Ring buffer for communication with firmware

- event-id	: SDEI event ID for receiving firmware notifications

Examples T9x
------------

sdei-ghes {
	compatible = "marvell,sdei-ghes";
	#address-cells = <2>;
	#size-cells = <1>;
	memory-region = <&ghes_hest_reserved>;
	/*
	 * Range placeholders; the addrs are set dynamically by
	 * firmware to match 'reg' in 'ghes_hest_reserved'.
	 */
	ranges = <0x0 0x00000000 0x0 0x0 0x00100>,
		 <0x0 0x00000100 0x0 0x0 0x00700>,
		 <0x0 0x00000800 0x0 0x0 0x08000>;
	mdc {
		reg = <0x0 0x00000000 0x008>,
		      <0x0 0x00000100 0x9D>,
		      <0x0 0x00000800 0x800>;
		event-id = <0x40000000>;
	};
	mcc {
		reg = <0x0 0x00000008 0x008>,
		      <0x0 0x00000200 0x9D>,
		      <0x0 0x00001000 0x800>;
		event-id = <0x40000001>;
	};
	lmc {
		reg = <0x0 0x00000010 0x008>,
		      <0x0 0x00000300 0x9D>,
		      <0x0 0x00001800 0x800>;
		event-id = <0x40000002>;
	};
};

Example CN10K:
-------------

sdei-ghes {
	compatible = "marvell,sdei-ghes";
	#address-cells = <2>;
	#size-cells = <1>;
	memory-region = <&ghes_hest_reserved>;
	ranges = <0x0 0x00000000 0x0 0x0 0x00400>,
		 <0x0 0x00000400 0x0 0x0 0x06800>,
		 <0x0 0x00007000 0x0 0x0 0xF9000>;
	core0 {
		reg = <0x0 0x00000000 0x008>,
		      <0x0 0x00000400 0xFA>,
		      <0x0 0x00007000 0x1600>;
		event-id = <0x40000003>;
	};
	core1..N {
		reg = <0x0 [core*8] 0x008>,
		      <0x0 [core*0x100 + 0x500] 0xFA>,
		      <0x0 [core*0x1600 + 0x8600] 0x1600>;
		event-id = <0x4000000[core]>;
	};
	mdc {
		reg = <0x0 0x000000C0 0x008>,
		      <0x0 0x00001C00 0x100>,
		      <0x0 0x00028000 0x800>;
		event-id = <0x40000000>;
	};
	dss {
		reg = <0x0 0x000000C8 0x008>,
		      <0x0 0x00001D00 0x100>,
		      <0x0 0x00028800 0x800>;
		event-id = <0x40000001>;
	};
	tad {
		reg = <0x0 0x000000D0 0x008>,
		      <0x0 0x00001E00 0x100>,
		      <0x0 0x00029000 0x800>;
		event-id = <0x40000002>;
	};
};

BED-BERT module provides the Boot Error Record Table (BERT)
to the kernel, which allows for reporting of fatal RAS errors
to Linux on a subsequent boot. Only OcteonTX2 support.

  BERT   - A virtual device that records fatal errors from any of the above
           into system preserved memory.
           NOTE: This is located in the 'bed-bert' node.

Device Tree bed-bert binding
----------------------------

Required properties:
- compatible: Shall be "marvell,bed-bert".

Required properties for bert subnode:
- reg		: Shall contain three entries, one for each of:
		  - GHES Error Status Address (ACPI 4.0a, sec 17.3.2.6)
		  - GHES Error Status Block   (ACPI 4.0a, sec 17.3.2.6.1)
		  - ring buffer for communication with firmware

Example
-------

/* Boot Error Data / BERT support */
bed-bert {
	compatible = "marvell,bed-bert";
	#address-cells = <2>;
	#size-cells = <2>;
	memory-region = <&ghes_bert_reserved>;
	/*
	 * Range placeholders; these are set dynamically by
	 * firmware to match 'reg' in 'ghes_bert_reserved'.
	 */
	ranges = <0x0 0x0 0x0 0x0 0x0 0x0>,
		 <0x0 0x0 0x0 0x0 0x0 0x0>,
		 <0x0 0x0 0x0 0x0 0x0 0x0>;
	bert {
		reg = <0x0 0x00000000 0x0 0x008>,
		      <0x0 0x00000100 0x0 0x100>,
		      <0x0 0x00000200 0x0 0x800>;
	};
};
```

## Documentation/devicetree/bindings/mailbox/marvell,mbox-mailbox.txt
```
Marvell MHU Mailbox driver
==========================

The Marvell's Message-Handing-Unit is a mailbox controller
with single channel/link to communicate with system coprocessor.
The link is hardwired on a platform. It uses simple
interrupt/shared memory scheme to send and receive the data.
The interrupt for mailbox may be configured in two ways.
The LPI interrupt, attached to MSIX vector from SCP PCI device.
Another option is SPI interrupt, tied to the platform.

Mailbox Device Node:
====================

Required properties:
--------------------
- compatible:		Shall be "marvell,mbox"
- reg:			Contains the mailbox registers address range
- #mbox-cells		Shall be 1 - the index of the channel needed
- interrupts:		Contains the interrupt information corresponding to
			the link od MHU. It's needed only in SPI configuration.
- shmem:		Shared memory address range.

Example:
--------

	mailbox@28,0 {
		compatible = "marvell,mbox";
		reg = <0xE000 0 0 0 0>;/*  DEVFN = 0xE0 (1C:0) */
		#mbox-cells = <1>;
		shmem = <&scp_to_cpu>;
	};

        ...

	sram@36,0 {
		compatible = "cpc-shmem";
		reg = <0x86D0 0xdd400 0 0x200>;

		#address-cells = <2>;
		#size-cells = <1>;
		ranges = <0 0x0 0x86D0 0xdd400 0x200>;

		scp_to_cpu: scp-shmem@0 {
			compatible = "cpc-shmem";
			reg = <0x0 0x0 0x200>;
		};
	};

or in case of SPI interrupt configuration,

	mailbox@82c000000000 {
		compatible = "marvell,mbox";
		reg = <0x82c0 0x00000000 0x0 0x100000>;
		#mbox-cells = <1>;
		interrupt-parent = <&gic0>;
		interrupts = <0 59 1>;
		shmem = <&scp_to_cpu>;
	};

	...

	sram@36,0 {
		compatible = "cpc-shmem";
		reg = <0x86D0 0xdd400 0 0x200>;

		#address-cells = <2>;
		#size-cells = <1>;
		ranges = <0 0x0 0x86D0 0xdd400 0x200>;

		scp_to_cpu: scp-shmem@0 {
			compatible = "cpc-shmem";
			reg = <0x0 0x0 0x200>;
		};
	};
```

## Documentation/devicetree/bindings/marvell-generic-uio.txt
```
* Marvell generic UIO

Required properties:

- compatible: should be "marvell,generic-uio".
- reg: reg address
- reg-name: reg name

Example:

CP11X_LABEL(uio_ethernet): EVALUATOR(uio_pp_, CP11X_NUM)@0 {
		compatible = "generic-uio";
		reg = <0x0 0x90000>, <0x130000 0x6000>,
				<0x220000 0x1000>;
		reg-names = "pp", "mspg", "cm3";
};
```

## Documentation/devicetree/bindings/marvell-uio-sam.txt
```
* Marvell UIO for Security Acceleration Module (SAM)

Required properties:

- compatible: should be "marvell,uio-sam".
- eip_access: phandler to EIP crypto driver

Example:

CP110_LABEL(uio_sam): uio_sam@800000 {
	compatible = "marvell,uio-sam";
	eip_access = <&CP110_LABEL(crypto)>;
};
```

## Documentation/devicetree/bindings/marvell-uio-xor.txt
```
* Marvell UIO for XOR driver

Required properties:

- compatible: should be "marvell,uio-xor-v2".
- xor_access: phandler to XOR driver

Example:
P110_LABEL(uio_xor1) {
	compatible = "marvell,uio-xor-v2";
	xor_access = <&CP110_LABEL(xor1)>;
};
```

## Documentation/devicetree/bindings/mfd/amd,pensando-elbasr.yaml
```yaml
# SPDX-License-Identifier: (GPL-2.0 OR BSD-2-Clause)
%YAML 1.2
---
$id: http://devicetree.org/schemas/mfd/amd,pensando-elbasr.yaml#
$schema: http://devicetree.org/meta-schemas/core.yaml#

title: AMD Pensando Elba SoC Resource Controller bindings

description: |
  AMD Pensando Elba SoC Resource Controller bindings attached to a SPI bus.

maintainers:
  - Brad Larson <blarson@amd.com>

properties:
  compatible:
    items:
      - enum:
          - amd,pensando-elbasr
      - const: simple-mfd

  spi-max-frequency:
    description: Maximum SPI frequency of the device in Hz.

  reg:
    maxItems: 1

  '#address-cells':
    const: 1

  '#size-cells':
    const: 0

  interrupts:
    maxItems: 1

required:
  - compatible
  - reg
  - spi-max-frequency

patternProperties:
  '^reset-controller@[a-f0-9]+$':
    $ref: ../reset/amd,pensando-elbasr-reset.yaml

additionalProperties: false

examples:
  - |
    #include <dt-bindings/reset/amd,pensando-elba-reset.h>
    #include <dt-bindings/interrupt-controller/arm-gic.h>

    spi0 {
        #address-cells = <1>;
        #size-cells = <0>;
        num-cs = <4>;

        spi@0 {
          compatible = "amd,pensando-elbasr", "simple-mfd";
          reg = <0>;
          #address-cells = <1>;
          #size-cells = <0>;
          spi-max-frequency = <12000000>;

          rstc: reset-controller@0 {
            compatible = "amd,pensando-elbasr-reset";
            reg = <0>;
            #reset-cells = <1>;
          };
        };

        spi@1 {
          compatible = "amd,pensando-elbasr", "simple-mfd";
          reg = <1>;
          spi-max-frequency = <12000000>;
        };

        spi@2 {
          compatible = "amd,pensando-elbasr", "simple-mfd";
          reg = <2>;
          spi-max-frequency = <12000000>;
          interrupt-parent = <&porta>;
          interrupts = <0 IRQ_TYPE_LEVEL_LOW>;
        };

        spi@3 {
          compatible = "amd,pensando-elbasr", "simple-mfd";
          reg = <3>;
          spi-max-frequency = <12000000>;
        };
    };

...
```

## Documentation/devicetree/bindings/mmc/cavium-mmc.txt
```
* Cavium Octeon & ThunderX MMC controller

The highspeed MMC host controller on Caviums SoCs provides an interface
for MMC and SD types of memory cards.

Supported maximum speeds are the ones of the eMMC standard 4.41 as well
as the speed of SD standard 4.0. Only 3.3 Volt is supported.

Required properties:
 - compatible : should be one of:
   cavium,octeon-6130-mmc
   cavium,octeon-7890-mmc
   cavium,thunder-8190-mmc
   cavium,thunder-8390-mmc
   mmc-slot
 - reg : mmc controller base registers
 - clocks : phandle

Optional properties:
 - for cd, bus-width, vmmc-supply, vqmmc-supply, and additional generic
   mmc parameters please refer to mmc.txt within this directory
 - cavium,cmd-clk-skew : number of coprocessor clocks before sampling command
 - cavium,dat-clk-skew : number of coprocessor clocks before sampling data

Deprecated properties:
 - spi-max-frequency : use max-frequency instead
 - cavium,bus-max-width : use bus-width instead
 - power-gpios : use vmmc-supply instead
 - cavium,octeon-6130-mmc-slot : use mmc-slot instead

GPIO control via vmmc-supply & vqmmc-supply:
  Two types of regulator object can be specified as mmc properties,
  typically regulator-fixed controlled by GPIO pins.

  Octeon/OcteonTX chips commonly use GPIO8 as an MMC-reset pin.
  In systems which may boot from MMC, it starts as input, and is gently
  pulled up/down by board logic to indicate the active sense of the
  signal. Chip reset then drives the signal in the opposite direction
  to effect a reset of target devices.
  Device tree should model this with a vmmc-supply regulator, gated by
  GPIO8, so GPIO8 is driven in the non-reset direction when MMC devices
  are probed, and held there until rmmod/shutdown/suspend.
  This allows a warm reboot to reset the MMC devices.

  Octeon/OcteonTX MMC supports up to 3 mmc slots, but any
  level-shifting to accommodate different signal voltages is
  done by external hardware, under control of an optional
  vqmmc regulator object, typically controlled by GPIO.

  If any mmc-slots have a vqmmc-supply property, it is taken as a warning
  that we must switch carefully between slots (unless they have the same
  vqmmc object), tri-stating MMC signals to avoid any transient states
  as level-shifters are enabled/disabled.

  Even when so-called bi-directional level shifters are used,
  this technique should be employed when using different bus-widths
  on different slots, disabling level shifters to avoid presenting
  non-uniform impedance across DATA0-7 & CMD when non-selected
  4-wide slots are left enabled, while accessing 8-wide targets.

  Note that it's not possible to specify multiple regulators
  controlled by same GPIO pin, but with different active state.
  If one GPIO line is require to switch voltage/routing between
  different mmc-slots, specify a vqmmc-supply on one slot, but
  not the other. The regulator_disable call on leaving that slot
  will implicitly switch the state to support the unmarked slot.

  There's no need to list vqmmc-supply if all the mmc-slots on
  a board run at same voltage, and have same width.

Examples:
	mmc_1_4: mmc@1,4 {
		compatible = "cavium,thunder-8390-mmc";
		reg = <0x0c00 0 0 0 0>;	/* DEVFN = 0x0c (1:4) */
		#address-cells = <1>;
		#size-cells = <0>;
		clocks = <&sclk>;

		mmc-slot@0 {
			compatible = "mmc-slot";
			reg = <0>;
			vmmc-supply = <&mmc_supply_3v3>;
			vqmmc-supply = <&vqmmc_3v3>;
			max-frequency = <52000000>;
			bus-width = <4>;
			cap-sd-highspeed;
		};

		mmc-slot@1 {
			compatible = "mmc-slot";
			reg = <1>;
			vmmc-supply = <&mmc_supply_3v3>;
			vqmmc-supply = <&vqmmc_1v8>;
			max-frequency = <100000000>;
			bus-width = <8>;
			cap-mmc-highspeed;
			non-removable;
		};
	};
```
