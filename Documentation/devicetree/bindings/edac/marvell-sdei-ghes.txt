## arch/sparc/Kconfig.debug
```kconfig
menu "Kernel hacking"

config TRACE_IRQFLAGS_SUPPORT
	bool
	default y

source "lib/Kconfig.debug"

config STRICT_DEVMEM
	bool "Filter access to /dev/mem"
	---help---
	  If this option is disabled, you allow userspace (root) access to all
	  of memory, including kernel and userspace memory. Accidental
	  access to this is obviously disastrous, but specific access can
	  be used by people debugging the kernel. Note that with PAT support
	  enabled, even in this case there are restrictions on /dev/mem
	  use due to the cache aliasing requirements.

	  If this option is switched on, the /dev/mem file only allows
	  userspace access to PCI space and the BIOS code and data regions.
	  This is sufficient for dosemu and X and all common users of
	  /dev/mem.

	  If in doubt, say Y.

config DEBUG_DCFLUSH
	bool "D-cache flush debugging"
	depends on SPARC64 && DEBUG_KERNEL

config MCOUNT
	bool
	depends on SPARC64
	depends on FUNCTION_TRACER
	default y

config FRAME_POINTER
	bool
	depends on MCOUNT
	default y

endmenu
```

## drivers/block/oracleasm/Kconfig
```kconfig
config ORACLEASM
	depends on BLK_DEV
	tristate "Support for Oracle ASM driver"
	default m
```

## drivers/crypto/cavium/cpt/Kconfig
```kconfig
#
# Cavium crypto device configuration
#

config CRYPTO_DEV_CPT
	tristate

config CRYPTO_DEV_OCTEONTX_CPT
	tristate "Support for OcteonTX CPT driver"
	depends on ARCH_THUNDER || COMPILE_TEST
	depends on PCI_MSI && 64BIT
	depends on OCTEONTX2_AF
	select CRYPTO_DEV_CPT
	help
		Support for Cavium Cryptographic Accelerator Unit (CPT)
		block found in OcteonTX series of processors.

		To compile this driver as modules, choose M here:
		the modules will be called octeontx-cpt and octeontx-cptvf.

config CRYPTO_DEV_OCTEONTX2_CPT
	tristate "Support for OcteonTX2 CPT driver"
	depends on ARCH_THUNDER || COMPILE_TEST
	depends on PCI_MSI && 64BIT
	depends on OCTEONTX2_AF
	select CRYPTO_DEV_CPT
	help
		Support for Cryptographic Accelerator Unit (CPT)
		block found in OcteonTX2 series of processors.

		To compile this driver as modules, choose M here:
		the modules will be called octeontx2-cpt and octeontx2-cptvf.
```

## drivers/crypto/marvell/Kconfig
```kconfig
config CRYPTO_DEV_MARVELL
	tristate

config CRYPTO_DEV_MARVELL_CESA
	tristate "Marvell's Cryptographic Engine driver"
	depends on PLAT_ORION || ARCH_MVEBU
	select CRYPTO_AES
	select CRYPTO_DES
	select CRYPTO_BLKCIPHER
	select CRYPTO_HASH
	select SRAM
	select CRYPTO_DEV_MARVELL
	help
	  This driver allows you to utilize the Cryptographic Engines and
	  Security Accelerator (CESA) which can be found on MVEBU and ORION
	  platforms.
	  This driver supports CPU offload through DMA transfers.

config CRYPTO_DEV_OCTEONTX_ZIP
	tristate "OcteonTX ZIP driver"
	depends on ARCH_THUNDER || COMPILE_TEST
	depends on PCI_MSI && 64BIT
	select CRYPTO_DEV_MARVELL
	default m
	help
	  Select this option to enable ZIP driver.
	  ZIP provides hardware compression/decompression support.
	  Support for Compression/Decompression unit (ZIP) block found
	  in OcteonTX and OcteonTX2 series of processors.
	  To compile this driver as modules, choose M.
```
